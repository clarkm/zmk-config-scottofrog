## config/boards/shields/scottofrog/Kconfig.defconfig
```kconfig
if SHIELD_SCOTTOFROG

config ZMK_KEYBOARD_NAME
    default "ScottoFrog"

config ZMK_COMBO_MAX_COMBOS_PER_KEY
    default 50

endif
```
